## kernel/arch/avr32/boards/atngw100/Kconfig
```kconfig
# Copyright Statement:
#
# This software/firmware and related documentation ("MediaTek Software") are
# protected under relevant copyright laws. The information contained herein
# is confidential and proprietary to MediaTek Inc. and/or its licensors.
# Without the prior written permission of MediaTek inc. and/or its licensors,
# any reproduction, modification, use or disclosure of MediaTek Software,
# and information contained herein, in whole or in part, shall be strictly prohibited.
#
# MediaTek Inc. (C) 2010. All rights reserved.
#
# BY OPENING THIS FILE, RECEIVER HEREBY UNEQUIVOCALLY ACKNOWLEDGES AND AGREES
# THAT THE SOFTWARE/FIRMWARE AND ITS DOCUMENTATIONS ("MEDIATEK SOFTWARE")
# RECEIVED FROM MEDIATEK AND/OR ITS REPRESENTATIVES ARE PROVIDED TO RECEIVER ON
# AN "AS-IS" BASIS ONLY. MEDIATEK EXPRESSLY DISCLAIMS ANY AND ALL WARRANTIES,
# EXPRESS OR IMPLIED, INCLUDING BUT NOT LIMITED TO THE IMPLIED WARRANTIES OF
# MERCHANTABILITY, FITNESS FOR A PARTICULAR PURPOSE OR NONINFRINGEMENT.
# NEITHER DOES MEDIATEK PROVIDE ANY WARRANTY WHATSOEVER WITH RESPECT TO THE
# SOFTWARE OF ANY THIRD PARTY WHICH MAY BE USED BY, INCORPORATED IN, OR
# SUPPLIED WITH THE MEDIATEK SOFTWARE, AND RECEIVER AGREES TO LOOK ONLY TO SUCH
# THIRD PARTY FOR ANY WARRANTY CLAIM RELATING THERETO. RECEIVER EXPRESSLY ACKNOWLEDGES
# THAT IT IS RECEIVER'S SOLE RESPONSIBILITY TO OBTAIN FROM ANY THIRD PARTY ALL PROPER LICENSES
# CONTAINED IN MEDIATEK SOFTWARE. MEDIATEK SHALL ALSO NOT BE RESPONSIBLE FOR ANY MEDIATEK
# SOFTWARE RELEASES MADE TO RECEIVER'S SPECIFICATION OR TO CONFORM TO A PARTICULAR
# STANDARD OR OPEN FORUM. RECEIVER'S SOLE AND EXCLUSIVE REMEDY AND MEDIATEK'S ENTIRE AND
# CUMULATIVE LIABILITY WITH RESPECT TO THE MEDIATEK SOFTWARE RELEASED HEREUNDER WILL BE,
# AT MEDIATEK'S OPTION, TO REVISE OR REPLACE THE MEDIATEK SOFTWARE AT ISSUE,
# OR REFUND ANY SOFTWARE LICENSE FEES OR SERVICE CHARGE PAID BY RECEIVER TO
# MEDIATEK FOR SUCH MEDIATEK SOFTWARE AT ISSUE.


# NGW100 customization

if BOARD_ATNGW100_COMMON

config BOARD_ATNGW100_MKII_LCD
	bool "Enable ATNGW100 mkII LCD interface"
	depends on BOARD_ATNGW100_MKII
	help
	  This enables the LCD controller (LCDC) in the AT32AP7000. Since the
	  LCDC is multiplexed with MACB1 (LAN) Ethernet port, only one can be
	  enabled at a time.

	  This choice enables the LCDC and disables the MACB1 interface marked
	  LAN on the PCB.

choice
	prompt "Select an NGW100 add-on board to support"
	default BOARD_ATNGW100_ADDON_NONE

config BOARD_ATNGW100_ADDON_NONE
	bool "None"

config BOARD_ATNGW100_EVKLCD10X
	bool "EVKLCD10X addon board"
	depends on BOARD_ATNGW100_MKI || BOARD_ATNGW100_MKII_LCD
	help
	  This enables support for the EVKLCD100 (QVGA) or EVKLCD101 (VGA)
	  addon board for the NGW100 and NGW100 mkII. By enabling this the LCD
	  controller and AC97 controller is added as platform devices.

config BOARD_ATNGW100_MRMT
	bool "Mediama RMT1/2 add-on board"
	help
	  This enables support for the Mediama RMT1 or RMT2 board.
	  RMT provides LCD support, AC97 codec and other
	  optional peripherals to the Atmel NGW100.

	  This choice disables the detect pin and the write-protect pin for the
	  MCI platform device, since it conflicts with the LCD platform device.
	  The MCI pins can be reenabled by editing the "add device function" but
	  this may break the setup for other displays that use these pins.

endchoice

choice
	prompt "LCD panel resolution on EVKLCD10X"
	depends on BOARD_ATNGW100_EVKLCD10X
	default BOARD_ATNGW100_EVKLCD10X_VGA

config BOARD_ATNGW100_EVKLCD10X_QVGA
	bool "QVGA (320x240)"

config BOARD_ATNGW100_EVKLCD10X_VGA
	bool "VGA (640x480)"

config BOARD_ATNGW100_EVKLCD10X_POW_QVGA
	bool "Powertip QVGA (320x240)"

endchoice

if BOARD_ATNGW100_MRMT
source	"arch/avr32/boards/atngw100/Kconfig_mrmt"
endif

endif	# BOARD_ATNGW100_COMMON
```

## kernel/arch/avr32/boards/atstk1000/Kconfig
```kconfig
# Copyright Statement:
#
# This software/firmware and related documentation ("MediaTek Software") are
# protected under relevant copyright laws. The information contained herein
# is confidential and proprietary to MediaTek Inc. and/or its licensors.
# Without the prior written permission of MediaTek inc. and/or its licensors,
# any reproduction, modification, use or disclosure of MediaTek Software,
# and information contained herein, in whole or in part, shall be strictly prohibited.
#
# MediaTek Inc. (C) 2010. All rights reserved.
#
# BY OPENING THIS FILE, RECEIVER HEREBY UNEQUIVOCALLY ACKNOWLEDGES AND AGREES
# THAT THE SOFTWARE/FIRMWARE AND ITS DOCUMENTATIONS ("MEDIATEK SOFTWARE")
# RECEIVED FROM MEDIATEK AND/OR ITS REPRESENTATIVES ARE PROVIDED TO RECEIVER ON
# AN "AS-IS" BASIS ONLY. MEDIATEK EXPRESSLY DISCLAIMS ANY AND ALL WARRANTIES,
# EXPRESS OR IMPLIED, INCLUDING BUT NOT LIMITED TO THE IMPLIED WARRANTIES OF
# MERCHANTABILITY, FITNESS FOR A PARTICULAR PURPOSE OR NONINFRINGEMENT.
# NEITHER DOES MEDIATEK PROVIDE ANY WARRANTY WHATSOEVER WITH RESPECT TO THE
# SOFTWARE OF ANY THIRD PARTY WHICH MAY BE USED BY, INCORPORATED IN, OR
# SUPPLIED WITH THE MEDIATEK SOFTWARE, AND RECEIVER AGREES TO LOOK ONLY TO SUCH
# THIRD PARTY FOR ANY WARRANTY CLAIM RELATING THERETO. RECEIVER EXPRESSLY ACKNOWLEDGES
# THAT IT IS RECEIVER'S SOLE RESPONSIBILITY TO OBTAIN FROM ANY THIRD PARTY ALL PROPER LICENSES
# CONTAINED IN MEDIATEK SOFTWARE. MEDIATEK SHALL ALSO NOT BE RESPONSIBLE FOR ANY MEDIATEK
# SOFTWARE RELEASES MADE TO RECEIVER'S SPECIFICATION OR TO CONFORM TO A PARTICULAR
# STANDARD OR OPEN FORUM. RECEIVER'S SOLE AND EXCLUSIVE REMEDY AND MEDIATEK'S ENTIRE AND
# CUMULATIVE LIABILITY WITH RESPECT TO THE MEDIATEK SOFTWARE RELEASED HEREUNDER WILL BE,
# AT MEDIATEK'S OPTION, TO REVISE OR REPLACE THE MEDIATEK SOFTWARE AT ISSUE,
# OR REFUND ANY SOFTWARE LICENSE FEES OR SERVICE CHARGE PAID BY RECEIVER TO
# MEDIATEK FOR SUCH MEDIATEK SOFTWARE AT ISSUE.


# STK1000 customization

if BOARD_ATSTK1000

choice
	prompt "ATSTK1000 CPU daughterboard type"
	default BOARD_ATSTK1002

config BOARD_ATSTK1002
	bool "ATSTK1002"
	select CPU_AT32AP7000

config BOARD_ATSTK1003
	bool "ATSTK1003"
	select CPU_AT32AP7001

config BOARD_ATSTK1004
	bool "ATSTK1004"
	select CPU_AT32AP7002

config BOARD_ATSTK1006
	bool "ATSTK1006"
	select CPU_AT32AP7000

endchoice


config BOARD_ATSTK100X_CUSTOM
	bool "Non-default STK1002/STK1003/STK1004 jumper settings"
	help
	  You will normally leave the jumpers on the CPU card at their
	  default settings.  If you need to use certain peripherals,
	  you will need to change some of those jumpers.

if BOARD_ATSTK100X_CUSTOM

config BOARD_ATSTK100X_SW1_CUSTOM
	bool "SW1: use SSC1 (not SPI0)"
	help
	  This also prevents using the external DAC as an audio interface,
	  and means you can't initialize the on-board QVGA display.

config BOARD_ATSTK100X_SW2_CUSTOM
	bool "SW2: use IRDA or TIMER0 (not UART-A, MMC/SD, and PS2-A)"
	help
	  If you change this you'll want an updated boot loader putting
	  the console on UART-C not UART-A.

config BOARD_ATSTK100X_SW3_CUSTOM
	bool "SW3: use TIMER1 (not SSC0 and GCLK)"
	help
	  This also prevents using the external DAC as an audio interface.

config BOARD_ATSTK100X_SW4_CUSTOM
	bool "SW4: use ISI/Camera (not GPIOs, SPI1, and PS2-B)"
	help
	  To use the camera interface you'll need a custom card (on the
	  PCI-format connector) connect a video sensor.

config BOARD_ATSTK1002_SW5_CUSTOM
	bool "SW5: use MACB1 (not LCDC)"
	depends on BOARD_ATSTK1002

config BOARD_ATSTK1002_SW6_CUSTOM
	bool "SW6: more GPIOs (not MACB0)"
	depends on BOARD_ATSTK1002

endif	# custom

config BOARD_ATSTK100X_SPI1
	bool "Configure SPI1 controller"
	depends on !BOARD_ATSTK100X_SW4_CUSTOM
	help
	  All the signals for the second SPI controller are available on
	  GPIO lines and accessed through the J1 jumper block.  Say "y"
	  here to configure that SPI controller.

config BOARD_ATSTK1000_J2_LED
	bool
	default BOARD_ATSTK1000_J2_LED8 || BOARD_ATSTK1000_J2_RGB

choice
	prompt "LEDs connected to J2:"
	depends on LEDS_GPIO && !BOARD_ATSTK100X_SW4_CUSTOM
	optional
	help
	  Select this if you have jumpered the J2 jumper block to the
	  LED0..LED7 amber leds, or to the RGB leds, using a ten-pin
	  IDC cable.  A default "heartbeat" trigger is provided, but
	  you can of course override this.

config BOARD_ATSTK1000_J2_LED8
	bool "LED0..LED7"
	help
	  Select this if J2 is jumpered to LED0..LED7 amber leds.

config BOARD_ATSTK1000_J2_RGB
	bool "RGB leds"
	help
	  Select this if J2 is jumpered to the RGB leds.

endchoice

config BOARD_ATSTK1000_EXTDAC
	bool
	depends on !BOARD_ATSTK100X_SW1_CUSTOM && !BOARD_ATSTK100X_SW3_CUSTOM
	default y

endif	# stk 1000
```

## kernel/arch/avr32/boards/favr-32/Kconfig
```kconfig
# Copyright Statement:
#
# This software/firmware and related documentation ("MediaTek Software") are
# protected under relevant copyright laws. The information contained herein
# is confidential and proprietary to MediaTek Inc. and/or its licensors.
# Without the prior written permission of MediaTek inc. and/or its licensors,
# any reproduction, modification, use or disclosure of MediaTek Software,
# and information contained herein, in whole or in part, shall be strictly prohibited.
#
# MediaTek Inc. (C) 2010. All rights reserved.
#
# BY OPENING THIS FILE, RECEIVER HEREBY UNEQUIVOCALLY ACKNOWLEDGES AND AGREES
# THAT THE SOFTWARE/FIRMWARE AND ITS DOCUMENTATIONS ("MEDIATEK SOFTWARE")
# RECEIVED FROM MEDIATEK AND/OR ITS REPRESENTATIVES ARE PROVIDED TO RECEIVER ON
# AN "AS-IS" BASIS ONLY. MEDIATEK EXPRESSLY DISCLAIMS ANY AND ALL WARRANTIES,
# EXPRESS OR IMPLIED, INCLUDING BUT NOT LIMITED TO THE IMPLIED WARRANTIES OF
# MERCHANTABILITY, FITNESS FOR A PARTICULAR PURPOSE OR NONINFRINGEMENT.
# NEITHER DOES MEDIATEK PROVIDE ANY WARRANTY WHATSOEVER WITH RESPECT TO THE
# SOFTWARE OF ANY THIRD PARTY WHICH MAY BE USED BY, INCORPORATED IN, OR
# SUPPLIED WITH THE MEDIATEK SOFTWARE, AND RECEIVER AGREES TO LOOK ONLY TO SUCH
# THIRD PARTY FOR ANY WARRANTY CLAIM RELATING THERETO. RECEIVER EXPRESSLY ACKNOWLEDGES
# THAT IT IS RECEIVER'S SOLE RESPONSIBILITY TO OBTAIN FROM ANY THIRD PARTY ALL PROPER LICENSES
# CONTAINED IN MEDIATEK SOFTWARE. MEDIATEK SHALL ALSO NOT BE RESPONSIBLE FOR ANY MEDIATEK
# SOFTWARE RELEASES MADE TO RECEIVER'S SPECIFICATION OR TO CONFORM TO A PARTICULAR
# STANDARD OR OPEN FORUM. RECEIVER'S SOLE AND EXCLUSIVE REMEDY AND MEDIATEK'S ENTIRE AND
# CUMULATIVE LIABILITY WITH RESPECT TO THE MEDIATEK SOFTWARE RELEASED HEREUNDER WILL BE,
# AT MEDIATEK'S OPTION, TO REVISE OR REPLACE THE MEDIATEK SOFTWARE AT ISSUE,
# OR REFUND ANY SOFTWARE LICENSE FEES OR SERVICE CHARGE PAID BY RECEIVER TO
# MEDIATEK FOR SUCH MEDIATEK SOFTWARE AT ISSUE.


# Favr-32 customization

if BOARD_FAVR_32

config BOARD_FAVR32_ABDAC_RATE
	int "DAC target rate"
	default 44100
	range 32000 50000
	help
	  Specify the target rate the internal DAC should try to match. This
	  will use PLL1 to generate a frequency as close as possible to this
	  rate.

	  Must be within the range 32000 to 50000, which should be suitable to
	  generate most other frequencies in power of 2 steps.

	  Ex:
		48000 will also suit 24000 and 12000
		44100 will also suit 22050 and 11025
		32000 will also suit 16000 and 8000

endif # BOARD_FAVR_32
```

## kernel/arch/avr32/boards/hammerhead/Kconfig
```kconfig
# Copyright Statement:
#
# This software/firmware and related documentation ("MediaTek Software") are
# protected under relevant copyright laws. The information contained herein
# is confidential and proprietary to MediaTek Inc. and/or its licensors.
# Without the prior written permission of MediaTek inc. and/or its licensors,
# any reproduction, modification, use or disclosure of MediaTek Software,
# and information contained herein, in whole or in part, shall be strictly prohibited.
#
# MediaTek Inc. (C) 2010. All rights reserved.
#
# BY OPENING THIS FILE, RECEIVER HEREBY UNEQUIVOCALLY ACKNOWLEDGES AND AGREES
# THAT THE SOFTWARE/FIRMWARE AND ITS DOCUMENTATIONS ("MEDIATEK SOFTWARE")
# RECEIVED FROM MEDIATEK AND/OR ITS REPRESENTATIVES ARE PROVIDED TO RECEIVER ON
# AN "AS-IS" BASIS ONLY. MEDIATEK EXPRESSLY DISCLAIMS ANY AND ALL WARRANTIES,
# EXPRESS OR IMPLIED, INCLUDING BUT NOT LIMITED TO THE IMPLIED WARRANTIES OF
# MERCHANTABILITY, FITNESS FOR A PARTICULAR PURPOSE OR NONINFRINGEMENT.
# NEITHER DOES MEDIATEK PROVIDE ANY WARRANTY WHATSOEVER WITH RESPECT TO THE
# SOFTWARE OF ANY THIRD PARTY WHICH MAY BE USED BY, INCORPORATED IN, OR
# SUPPLIED WITH THE MEDIATEK SOFTWARE, AND RECEIVER AGREES TO LOOK ONLY TO SUCH
# THIRD PARTY FOR ANY WARRANTY CLAIM RELATING THERETO. RECEIVER EXPRESSLY ACKNOWLEDGES
# THAT IT IS RECEIVER'S SOLE RESPONSIBILITY TO OBTAIN FROM ANY THIRD PARTY ALL PROPER LICENSES
# CONTAINED IN MEDIATEK SOFTWARE. MEDIATEK SHALL ALSO NOT BE RESPONSIBLE FOR ANY MEDIATEK
# SOFTWARE RELEASES MADE TO RECEIVER'S SPECIFICATION OR TO CONFORM TO A PARTICULAR
# STANDARD OR OPEN FORUM. RECEIVER'S SOLE AND EXCLUSIVE REMEDY AND MEDIATEK'S ENTIRE AND
# CUMULATIVE LIABILITY WITH RESPECT TO THE MEDIATEK SOFTWARE RELEASED HEREUNDER WILL BE,
# AT MEDIATEK'S OPTION, TO REVISE OR REPLACE THE MEDIATEK SOFTWARE AT ISSUE,
# OR REFUND ANY SOFTWARE LICENSE FEES OR SERVICE CHARGE PAID BY RECEIVER TO
# MEDIATEK FOR SUCH MEDIATEK SOFTWARE AT ISSUE.


# Hammerhead customization

if BOARD_HAMMERHEAD

config BOARD_HAMMERHEAD_USB
	bool "Philips ISP116x-hcd USB support"
	help
	  This enables USB support for Hammerheads internal ISP116x
	  controller from Philips.

	  Choose 'Y' here if you want to have your board USB driven.

config BOARD_HAMMERHEAD_LCD
	bool "Atmel AT91/AT32 LCD support"
	help
	  This enables LCD support for the Hammerhead board. You may
	  also add support for framebuffer devices (AT91/AT32 LCD Controller)
	  and framebuffer console support to get the most out of your LCD.

	  Choose 'Y' here if you have ordered a Corona daugther board and
	  want to have support for your Hantronix HDA-351T-LV LCD.

config BOARD_HAMMERHEAD_SND
	bool "Atmel AC97 Sound support"
	help
	  This enables Sound support for the Hammerhead board. You may
	  also go through the ALSA settings to get it working.

	  Choose 'Y' here if you have ordered a Corona daugther board and
	  want to make your board funky.

config BOARD_HAMMERHEAD_FPGA
	bool "Hammerhead FPGA Support"
	default y
	help
	  This adds support for the Cyclone III FPGA from Altera
	  found on Miromico's Hammerhead board.

	  Choose 'Y' here if you want to have FPGA support enabled.
	  You will have to choose the "Hammerhead FPGA Device Support" in
	  Device Drivers->Misc to be able to use FPGA functionality.

endif	# BOARD_ATNGW100
```
