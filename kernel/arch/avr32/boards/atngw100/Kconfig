## kernel/arch/powerpc/platforms/512x/Kconfig
```kconfig
# Copyright Statement:
#
# This software/firmware and related documentation ("MediaTek Software") are
# protected under relevant copyright laws. The information contained herein
# is confidential and proprietary to MediaTek Inc. and/or its licensors.
# Without the prior written permission of MediaTek inc. and/or its licensors,
# any reproduction, modification, use or disclosure of MediaTek Software,
# and information contained herein, in whole or in part, shall be strictly prohibited.
#
# MediaTek Inc. (C) 2010. All rights reserved.
#
# BY OPENING THIS FILE, RECEIVER HEREBY UNEQUIVOCALLY ACKNOWLEDGES AND AGREES
# THAT THE SOFTWARE/FIRMWARE AND ITS DOCUMENTATIONS ("MEDIATEK SOFTWARE")
# RECEIVED FROM MEDIATEK AND/OR ITS REPRESENTATIVES ARE PROVIDED TO RECEIVER ON
# AN "AS-IS" BASIS ONLY. MEDIATEK EXPRESSLY DISCLAIMS ANY AND ALL WARRANTIES,
# EXPRESS OR IMPLIED, INCLUDING BUT NOT LIMITED TO THE IMPLIED WARRANTIES OF
# MERCHANTABILITY, FITNESS FOR A PARTICULAR PURPOSE OR NONINFRINGEMENT.
# NEITHER DOES MEDIATEK PROVIDE ANY WARRANTY WHATSOEVER WITH RESPECT TO THE
# SOFTWARE OF ANY THIRD PARTY WHICH MAY BE USED BY, INCORPORATED IN, OR
# SUPPLIED WITH THE MEDIATEK SOFTWARE, AND RECEIVER AGREES TO LOOK ONLY TO SUCH
# THIRD PARTY FOR ANY WARRANTY CLAIM RELATING THERETO. RECEIVER EXPRESSLY ACKNOWLEDGES
# THAT IT IS RECEIVER'S SOLE RESPONSIBILITY TO OBTAIN FROM ANY THIRD PARTY ALL PROPER LICENSES
# CONTAINED IN MEDIATEK SOFTWARE. MEDIATEK SHALL ALSO NOT BE RESPONSIBLE FOR ANY MEDIATEK
# SOFTWARE RELEASES MADE TO RECEIVER'S SPECIFICATION OR TO CONFORM TO A PARTICULAR
# STANDARD OR OPEN FORUM. RECEIVER'S SOLE AND EXCLUSIVE REMEDY AND MEDIATEK'S ENTIRE AND
# CUMULATIVE LIABILITY WITH RESPECT TO THE MEDIATEK SOFTWARE RELEASED HEREUNDER WILL BE,
# AT MEDIATEK'S OPTION, TO REVISE OR REPLACE THE MEDIATEK SOFTWARE AT ISSUE,
# OR REFUND ANY SOFTWARE LICENSE FEES OR SERVICE CHARGE PAID BY RECEIVER TO
# MEDIATEK FOR SUCH MEDIATEK SOFTWARE AT ISSUE.


config PPC_MPC512x
	bool
	select FSL_SOC
	select IPIC
	select PPC_CLOCK
	select PPC_PCI_CHOICE
	select FSL_PCI if PCI

config PPC_MPC5121
	bool
	select PPC_MPC512x

config MPC5121_ADS
	bool "Freescale MPC5121E ADS"
	depends on 6xx
	select DEFAULT_UIMAGE
	select PPC_MPC5121
	select MPC5121_ADS_CPLD
	help
	  This option enables support for the MPC5121E ADS board.

config MPC5121_GENERIC
	bool "Generic support for simple MPC5121 based boards"
	depends on 6xx
	select DEFAULT_UIMAGE
	select PPC_MPC5121
	help
	  This option enables support for simple MPC5121 based boards
	  which do not need custom platform specific setup.

	  Compatible boards include:  Protonic LVT base boards (ZANMCU
	  and VICVT2).
```

## kernel/arch/powerpc/platforms/52xx/Kconfig
```kconfig
# Copyright Statement:
#
# This software/firmware and related documentation ("MediaTek Software") are
# protected under relevant copyright laws. The information contained herein
# is confidential and proprietary to MediaTek Inc. and/or its licensors.
# Without the prior written permission of MediaTek inc. and/or its licensors,
# any reproduction, modification, use or disclosure of MediaTek Software,
# and information contained herein, in whole or in part, shall be strictly prohibited.
#
# MediaTek Inc. (C) 2010. All rights reserved.
#
# BY OPENING THIS FILE, RECEIVER HEREBY UNEQUIVOCALLY ACKNOWLEDGES AND AGREES
# THAT THE SOFTWARE/FIRMWARE AND ITS DOCUMENTATIONS ("MEDIATEK SOFTWARE")
# RECEIVED FROM MEDIATEK AND/OR ITS REPRESENTATIVES ARE PROVIDED TO RECEIVER ON
# AN "AS-IS" BASIS ONLY. MEDIATEK EXPRESSLY DISCLAIMS ANY AND ALL WARRANTIES,
# EXPRESS OR IMPLIED, INCLUDING BUT NOT LIMITED TO THE IMPLIED WARRANTIES OF
# MERCHANTABILITY, FITNESS FOR A PARTICULAR PURPOSE OR NONINFRINGEMENT.
# NEITHER DOES MEDIATEK PROVIDE ANY WARRANTY WHATSOEVER WITH RESPECT TO THE
# SOFTWARE OF ANY THIRD PARTY WHICH MAY BE USED BY, INCORPORATED IN, OR
# SUPPLIED WITH THE MEDIATEK SOFTWARE, AND RECEIVER AGREES TO LOOK ONLY TO SUCH
# THIRD PARTY FOR ANY WARRANTY CLAIM RELATING THERETO. RECEIVER EXPRESSLY ACKNOWLEDGES
# THAT IT IS RECEIVER'S SOLE RESPONSIBILITY TO OBTAIN FROM ANY THIRD PARTY ALL PROPER LICENSES
# CONTAINED IN MEDIATEK SOFTWARE. MEDIATEK SHALL ALSO NOT BE RESPONSIBLE FOR ANY MEDIATEK
# SOFTWARE RELEASES MADE TO RECEIVER'S SPECIFICATION OR TO CONFORM TO A PARTICULAR
# STANDARD OR OPEN FORUM. RECEIVER'S SOLE AND EXCLUSIVE REMEDY AND MEDIATEK'S ENTIRE AND
# CUMULATIVE LIABILITY WITH RESPECT TO THE MEDIATEK SOFTWARE RELEASED HEREUNDER WILL BE,
# AT MEDIATEK'S OPTION, TO REVISE OR REPLACE THE MEDIATEK SOFTWARE AT ISSUE,
# OR REFUND ANY SOFTWARE LICENSE FEES OR SERVICE CHARGE PAID BY RECEIVER TO
# MEDIATEK FOR SUCH MEDIATEK SOFTWARE AT ISSUE.


config PPC_MPC52xx
	bool "52xx-based boards"
	depends on 6xx
	select PPC_CLOCK
	select PPC_PCI_CHOICE

config PPC_MPC5200_SIMPLE
	bool "Generic support for simple MPC5200 based boards"
	depends on PPC_MPC52xx
	select DEFAULT_UIMAGE
	help
	  This option enables support for a simple MPC52xx based boards which
	  do not need a custom platform specific setup. Such boards are
	  supported assuming the following:

	  - GPIO pins are configured by the firmware,
	  - CDM configuration (clocking) is setup correctly by firmware,
	  - if the 'fsl,has-wdt' property is present in one of the
	    gpt nodes, then it is safe to use such gpt to reset the board,
	  - PCI is supported if enabled in the kernel configuration
	    and if there is a PCI bus node defined in the device tree.

	  Boards that are compatible with this generic platform support
	  are:
	     intercontrol,digsy-mtc
	     phytec,pcm030
	     phytec,pcm032
	     promess,motionpro
	     schindler,cm5200
	     tqc,tqm5200

config PPC_EFIKA
	bool "bPlan Efika 5k2. MPC5200B based computer"
	depends on PPC_MPC52xx
	select PPC_RTAS
	select RTAS_PROC
	select PPC_NATIVE

config PPC_LITE5200
	bool "Freescale Lite5200 Eval Board"
	depends on PPC_MPC52xx
	select DEFAULT_UIMAGE

config PPC_MEDIA5200
	bool "Freescale Media5200 Eval Board"
	depends on PPC_MPC52xx
	select DEFAULT_UIMAGE

config PPC_MPC5200_BUGFIX
	bool "MPC5200 (L25R) bugfix support"
	depends on PPC_MPC52xx
	help
	  Enable workarounds for original MPC5200 errata.  This is not required
	  for MPC5200B based boards.

	  It is safe to say 'Y' here

config PPC_MPC5200_GPIO
	bool "MPC5200 GPIO support"
	depends on PPC_MPC52xx
	select ARCH_REQUIRE_GPIOLIB
	select GENERIC_GPIO
	help
	  Enable gpiolib support for mpc5200 based boards

config PPC_MPC5200_LPBFIFO
	tristate "MPC5200 LocalPlus bus FIFO driver"
	depends on PPC_MPC52xx
	select PPC_BESTCOMM_GEN_BD
```
